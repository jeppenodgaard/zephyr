/*
 * Copyright (c) 2023 Prevas A/S
 *
 * SPDX-License-Identifier: Apache-2.0
 */

/ {
	chosen {
		/*
		 * shared memory reserved for the inter-processor communication
		 */
		zephyr,ipc_shm = &ocram_overlay;
		zephyr,ipc = &mailbox0;
	};

	/*
	 * Use first 32 KB of 576 KB of the OCRAM for IPC
	 * Note that shared memory must have specific MPU attributes set
	 */
	ocram_overlay: memory@20200000 {
		compatible = "zephyr,memory-region", "mmio-sram";
		reg = <0x20200000 DT_SIZE_K(32)>;
		zephyr,memory-region = "OCRAM_OVERLAY";
		zephyr,memory-region-mpu = "IO";
	};
};
